/*
 * Copyright (c) 2024 Tenstorrent AI ULC
 *
 * SPDX-License-Identifier: Apache-2.0
 */

&jtag0 {
	tck-gpios = <&gpiob 10 GPIO_ACTIVE_HIGH>;
	tdi-gpios = <&gpiob 15 GPIO_ACTIVE_HIGH>;
	tdo-gpios = <&gpiob 1 GPIO_PULL_UP>;
	tms-gpios = <&gpiob 2 GPIO_ACTIVE_HIGH>;
	trst-gpios = <&gpiod 0 GPIO_ACTIVE_LOW>;
};

&flash1 {
	jedec-id = [20 bb 20];
};
